## srcpkgs/linux5.5-pf/files/pf_defconfig
```kconfig
CONFIG_SCHED_BMQ=y
CONFIG_SCHED_TIMESLICE=2
CONFIG_VIRT_CPU_ACCOUNTING=y
CONFIG_VIRT_CPU_ACCOUNTING_GEN=y
# CONFIG_PSI_DEFAULT_DISABLED is not set
# CONFIG_NO_HZ_IDLE is not set
CONFIG_NO_HZ_FULL=y
CONFIG_CONTEXT_TRACKING=y
# CONFIG_CONTEXT_TRACKING_FORCE is not set
CONFIG_NO_HZ=y
# CONFIG_HZ_300 is not set
CONFIG_HZ_1000=y
CONFIG_HZ=1000
CONFIG_RCU_EXPERT=y
CONFIG_RCU_FANOUT=32
CONFIG_RCU_FANOUT_LEAF=16
CONFIG_RCU_FAST_NO_HZ=y
CONFIG_RCU_NOCB_CPU=y
# CONFIG_UID16 is not set
# CONFIG_SYSFS_SYSCALL is not set
# CONFIG_PCSPKR_PLATFORM is not set
CONFIG_KALLSYMS_ALL=y
# CONFIG_SCHED_OMIT_FRAME_POINTER is not set
CONFIG_X86_INTEL_USERCOPY=y
CONFIG_X86_USE_PPRO_CHECKSUM=y
CONFIG_X86_P6_NOP=y
CONFIG_PROCESSOR_SELECT=y
# CONFIG_GART_IOMMU is not set
CONFIG_X86_MCELOG_LEGACY=y
CONFIG_PERF_EVENTS_INTEL_RAPL=y
CONFIG_PERF_EVENTS_INTEL_CSTATE=y
CONFIG_X86_MSR=y
CONFIG_X86_CPUID=y
CONFIG_X86_5LEVEL=y
CONFIG_AMD_MEM_ENCRYPT=y
# CONFIG_AMD_MEM_ENCRYPT_ACTIVE_BY_DEFAULT is not set
CONFIG_X86_PMEM_LEGACY=m
CONFIG_X86_INTEL_TSX_MODE_AUTO=y
CONFIG_RANDOMIZE_MEMORY_PHYSICAL_PADDING=0x1
CONFIG_PM_DEBUG=y
CONFIG_PM_ADVANCED_DEBUG=y
CONFIG_PM_SLEEP_DEBUG=y
# CONFIG_WQ_POWER_EFFICIENT_DEFAULT is not set
# CONFIG_PM_TRACE_RTC is not set
# CONFIG_DPM_WATCHDOG is not set
# CONFIG_PM_TEST_SUSPEND is not set
CONFIG_CPU_FREQ_STAT=y
CONFIG_CPU_FREQ_DEFAULT_GOV_PERFORMANCE=y
# CONFIG_CPU_FREQ_DEFAULT_GOV_ONDEMAND is not set
# CONFIG_CPU_FREQ_GOV_POWERSAVE is not set
# CONFIG_CPU_FREQ_GOV_USERSPACE is not set
# CONFIG_CPU_FREQ_GOV_CONSERVATIVE is not set
# CONFIG_CPU_FREQ_GOV_SCHEDUTIL is not set
CONFIG_HALTPOLL_CPUIDLE=m
CONFIG_DMI_SYSFS=y
CONFIG_EFI_BOOTLOADER_CONTROL=y
CONFIG_EFI_CAPSULE_LOADER=y
# CONFIG_EFI_TEST is not set
CONFIG_EFI_RCI2_TABLE=y
# CONFIG_STACKPROTECTOR_STRONG is not set
CONFIG_GCC_PLUGINS=y
CONFIG_TCP_CONG_BBR=y
CONFIG_DEFAULT_BBR=y
# CONFIG_DEFAULT_RENO is not set
CONFIG_DEFAULT_TCP_CONG="bbr"
CONFIG_NVME_HWMON=y
CONFIG_MAC80211_HWSIM=m
CONFIG_KEYBOARD_APPLESPI=m
CONFIG_THERMAL_EMERGENCY_POWEROFF_DELAY_MS=100
CONFIG_THERMAL_HWMON=y
CONFIG_THERMAL_GOV_FAIR_SHARE=y
# CONFIG_THERMAL_GOV_POWER_ALLOCATOR is not set
# CONFIG_CLOCK_THERMAL is not set
# CONFIG_DEVFREQ_THERMAL is not set
CONFIG_THERMAL_EMULATION=y
CONFIG_INTEL_SOC_DTS_THERMAL=m
CONFIG_INTEL_BXT_PMIC_THERMAL=m
CONFIG_USB_AIRSPY=m
CONFIG_USB_HACKRF=m
# CONFIG_USB_MSI2500 is not set
CONFIG_DRM_LEGACY=y
CONFIG_VGA_SWITCHEROO=y
CONFIG_SND_HDA_POWER_SAVE_DEFAULT=10
CONFIG_SND_SOC_INTEL_CML_H=m
CONFIG_SND_SOC_INTEL_CML_LP=m
CONFIG_SND_SOC_INTEL_BYT_CHT_CX2072X_MACH=m
CONFIG_SND_SOC_INTEL_CML_LP_DA7219_MAX98357A_MACH=m
CONFIG_SND_SOC_INTEL_SOF_CML_RT1011_RT5682_MACH=m
CONFIG_SND_SOC_SOF_COMETLAKE_LP=m
CONFIG_SND_SOC_SOF_COMETLAKE_LP_SUPPORT=y
CONFIG_SND_SOC_SOF_COMETLAKE_H=m
CONFIG_SND_SOC_SOF_COMETLAKE_H_SUPPORT=y
CONFIG_VIRTIO_PMEM=m
CONFIG_INTEL_TURBO_MAX_3=y
CONFIG_INTEL_CHTDC_TI_PWRBTN=m
CONFIG_INTEL_ATOMISP2_PM=y
CONFIG_INTEL_SPEED_SELECT_INTERFACE=m
CONFIG_IOMMU_DEFAULT_PASSTHROUGH=y
# CONFIG_DEVFREQ_GOV_POWERSAVE is not set
# CONFIG_DEVFREQ_GOV_USERSPACE is not set
# CONFIG_DEVFREQ_GOV_PASSIVE is not set
# CONFIG_PM_DEVFREQ_EVENT is not set
# CONFIG_IDLE_INJECT is not set
# CONFIG_MCB is not set
CONFIG_ARCH_HAS_FORCE_DMA_UNENCRYPTED=y
CONFIG_FONT_8x8=y
CONFIG_FONT_7x14=y
CONFIG_FONT_10x18=y
CONFIG_STACKDEPOT=y
CONFIG_FRAME_POINTER=y
CONFIG_LATENCYTOP=y
CONFIG_UNWINDER_FRAME_POINTER=y
CONFIG_SCHED_HRTICK=y
CONFIG_SECURITY_TOMOYO=y
CONFIG_RANDOM_TRUST_CPU=y
CONFIG_USER_NS_UNPRIVILEGED=y
CONFIG_CC_OPTIMIZE_FOR_PERFORMANCE_O3=y
CONFIG_MCORE2=y
# CONFIG_GENERIC_CPU is not set
```
